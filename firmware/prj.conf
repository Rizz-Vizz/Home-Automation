## CMakeLists.txt
```
cmake_minimum_required(VERSION 3.22.0)

cmake_path(APPEND conf_file_path ${CMAKE_CURRENT_LIST_DIR} board prj.conf)
set(CONF_FILE ${conf_file_path} ${CONF_FILE})

include(${SdkRootDirPath}/cmake/extension/mcux.cmake)

project(elly_edge_fw LANGUAGES C CXX ASM PROJECT_BOARD_PORT_PATH ${board_root}/${board}/freertos_examples/freertos_hello)

include(${SdkRootDirPath}/CMakeLists.txt)
include(board/board_files.cmake)

mcux_add_source(
    SOURCES
        src/main.c
        src/comms.c
        src/rgb_led.c
        src/crypto_auth.c
        src/flash_log.c
        src/sensors.c
        src/tasks_ctrl.c
)

mcux_add_include(
    INCLUDES
        .
        src
)

mcux_convert_binary(BINARY ${APPLICATION_BINARY_DIR}/${MCUX_SDK_PROJECT_NAME}.bin)
```

## prj.conf
```kconfig
CONFIG_MCUX_COMPONENT_middleware.freertos-kernel=y
CONFIG_MCUX_PRJSEG_middleware.freertos-kernel.generated_config=y
CONFIG_MCUX_COMPONENT_middleware.freertos-kernel.cm33_non_trustzone=y
CONFIG_MCUX_COMPONENT_middleware.freertos-kernel.heap_4=y
CONFIG_configTICK_RATE_HZ=1000
CONFIG_configTOTAL_HEAP_SIZE=49152
CONFIG_configMAX_PRIORITIES=7
CONFIG_configUSE_MUTEXES=y
CONFIG_configUSE_TIMERS=y
CONFIG_configTIMER_TASK_PRIORITY="3"
CONFIG_configTIMER_QUEUE_LENGTH=10
CONFIG_configTIMER_TASK_STACK_DEPTH="256"
CONFIG_configCHECK_FOR_STACK_OVERFLOW=y
CONFIG_configUSE_MALLOC_FAILED_HOOK=y

CONFIG_MCUX_COMPONENT_driver.gpio=y
CONFIG_MCUX_COMPONENT_driver.port=y
CONFIG_MCUX_COMPONENT_driver.lpflexcomm_lpi2c=y
CONFIG_MCUX_COMPONENT_driver.lpflexcomm_lpuart=y
CONFIG_MCUX_COMPONENT_driver.lpflexcomm_lpspi=y
CONFIG_MCUX_COMPONENT_driver.ctimer=y
CONFIG_MCUX_COMPONENT_driver.lpadc=y
CONFIG_MCUX_COMPONENT_driver.vref_1=y
CONFIG_MCUX_COMPONENT_driver.pdm=y
CONFIG_MCUX_COMPONENT_driver.flexcan=y
CONFIG_MCUX_COMPONENT_driver.romapi_flashiap=y
CONFIG_MCUX_COMPONENT_driver.inputmux=y
CONFIG_MCUX_COMPONENT_driver.inputmux_connections=y
```

## src/main.c
```c
#include "app.h"
#include "comms.h"
#include "crypto_auth.h"
#include "rgb_led.h"
#include "tasks_ctrl.h"
#include "FreeRTOS.h"
#include "task.h"

void vApplicationStackOverflowHook(TaskHandle_t xTask, char *pcTaskName)
{
    (void)xTask;
    (void)pcTaskName;
    RgbLed_Set(100U, 0U, 0U);
    taskDISABLE_INTERRUPTS();
    for (;;) {
    }
}

void vApplicationMallocFailedHook(void)
{
    RgbLed_Set(100U, 0U, 50U);
    taskDISABLE_INTERRUPTS();
    for (;;) {
    }
}

int main(void)
{
    BOARD_InitHardware();
    Comms_Init();
    RgbLed_Init();
    CryptoAuth_Init();

    TasksCtrl_Start();
    vTaskStartScheduler();

    for (;;) {
    }
}
```

## src/comms.c
```c
#include "comms.h"
#include "app.h"
#include "fsl_lpuart.h"
#include "FreeRTOS.h"
#include "queue.h"
#include "semphr.h"
#include <ctype.h>
#include <stdlib.h>
#include <string.h>

#define RX_QUEUE_DEPTH 8U

typedef struct {
    char text[ELLY_RX_LINE_MAX];
} comms_line_t;

static SemaphoreHandle_t s_txMutex = NULL;
static QueueHandle_t s_rxQueue   = NULL;

static char s_isrLineBuf[ELLY_RX_LINE_MAX];
static size_t s_isrLineLen = 0U;
static bool s_isrOverflow = false;

void ELLY_UART_IRQHandler(void)
{
    BaseType_t higherWoken = pdFALSE;
    uint32_t status = LPUART_GetStatusFlags(ELLY_UART_BASE);

    if ((status & (uint32_t)kLPUART_RxOverrunFlag) != 0U) {
        LPUART_ClearStatusFlags(ELLY_UART_BASE, (uint32_t)kLPUART_RxOverrunFlag);
    }

    while ((LPUART_GetStatusFlags(ELLY_UART_BASE) & (uint32_t)kLPUART_RxDataRegFullFlag) != 0U) {
        uint8_t ch = LPUART_ReadByte(ELLY_UART_BASE);
        if (ch == (uint8_t)'\r') {
            continue;
        }
        if (ch == (uint8_t)'\n') {
            if ((s_isrLineLen > 0U) && !s_isrOverflow && (s_rxQueue != NULL)) {
                comms_line_t msg;
                memcpy(msg.text, s_isrLineBuf, s_isrLineLen);
                msg.text[s_isrLineLen] = '\0';
                (void)xQueueSendFromISR(s_rxQueue, &msg, &higherWoken);
            }
            s_isrLineLen  = 0U;
            s_isrOverflow = false;
        } else if (s_isrOverflow) {
            /* discard the rest of an oversized line up to the next newline */
        } else if (s_isrLineLen < (ELLY_RX_LINE_MAX - 1U)) {
            s_isrLineBuf[s_isrLineLen++] = (char)ch;
        } else {
            s_isrOverflow = true;
        }
    }

    portYIELD_FROM_ISR(higherWoken);
}

void Comms_Init(void)
{
    lpuart_config_t cfg;

    if (s_txMutex == NULL) {
        s_txMutex = xSemaphoreCreateMutex();
    }
    if (s_rxQueue == NULL) {
        s_rxQueue = xQueueCreate(RX_QUEUE_DEPTH, sizeof(comms_line_t));
    }

    LPUART_GetDefaultConfig(&cfg);
    cfg.baudRate_Bps = ELLY_UART_BAUDRATE;
    cfg.enableTx     = true;
    cfg.enableRx     = true;

    LPUART_Init(ELLY_UART_BASE, &cfg, ELLY_UART_CLK_FREQ);
    LPUART_EnableInterrupts(ELLY_UART_BASE,
                            (uint32_t)kLPUART_RxDataRegFullInterruptEnable |
                            (uint32_t)kLPUART_RxOverrunInterruptEnable);
    NVIC_SetPriority(ELLY_UART_IRQn, ELLY_ISR_PRIORITY);
    EnableIRQ(ELLY_UART_IRQn);
}

void Comms_SendLine(const char *jsonLine)
{
    static const uint8_t crlf[2] = { '\r', '\n' };
    if (jsonLine == NULL) {
        return;
    }

    if ((s_txMutex != NULL) && (xTaskGetSchedulerState() == taskSCHEDULER_RUNNING)) {
        (void)xSemaphoreTake(s_txMutex, portMAX_DELAY);
    }

    (void)LPUART_WriteBlocking(ELLY_UART_BASE, (const uint8_t *)jsonLine, strlen(jsonLine));
    (void)LPUART_WriteBlocking(ELLY_UART_BASE, crlf, sizeof(crlf));

    if ((s_txMutex != NULL) && (xTaskGetSchedulerState() == taskSCHEDULER_RUNNING)) {
        (void)xSemaphoreGive(s_txMutex);
    }
}

bool Comms_ReceiveLine(char *outBuf, size_t maxLen, uint32_t waitMs)
{
    comms_line_t msg;
    TickType_t ticks = (waitMs == portMAX_DELAY) ? portMAX_DELAY : pdMS_TO_TICKS(waitMs);

    if ((s_rxQueue == NULL) || (outBuf == NULL) || (maxLen == 0U)) {
        return false;
    }

    if (xQueueReceive(s_rxQueue, &msg, ticks) != pdTRUE) {
        return false;
    }

    size_t len = strlen(msg.text);
    if (len >= maxLen) {
        len = maxLen - 1U;
    }
    memcpy(outBuf, msg.text, len);
    outBuf[len] = '\0';
    return true;
}

static const char *find_json_key(const char *json, const char *key)
{
    char pattern[48];
    size_t klen = strlen(key);
    if ((json == NULL) || (klen + 3U >= sizeof(pattern))) {
        return NULL;
    }
    pattern[0] = '"';
    memcpy(&pattern[1], key, klen);
    pattern[klen + 1U] = '"';
    pattern[klen + 2U] = '\0';

    const char *p = json;
    while ((p = strstr(p, pattern)) != NULL) {
        const char *after = p + klen + 2U;
        while ((*after != '\0') && isspace((unsigned char)*after)) {
            after++;
        }
        if (*after == ':') {
            after++;
            while ((*after != '\0') && isspace((unsigned char)*after)) {
                after++;
            }
            return after;
        }
        p += klen + 2U;
    }
    return NULL;
}

bool Comms_JsonGetString(const char *json, const char *key, char *out, size_t maxLen)
{
    const char *val = find_json_key(json, key);
    if ((val == NULL) || (*val != '"') || (out == NULL) || (maxLen == 0U)) {
        return false;
    }
    val++;
    size_t idx = 0U;
    while ((*val != '\0') && (*val != '"')) {
        if ((*val == '\\') && (val[1] != '\0')) {
            val++;
        }
        if (idx + 1U < maxLen) {
            out[idx++] = *val;
        }
        val++;
    }
    out[idx] = '\0';
    return (*val == '"');
}

bool Comms_JsonGetUint(const char *json, const char *key, uint32_t *outVal)
{
    const char *val = find_json_key(json, key);
    if ((val == NULL) || (outVal == NULL) || !isdigit((unsigned char)*val)) {
        return false;
    }
    char *endp = NULL;
    unsigned long parsed = strtoul(val, &endp, 10);
    if (endp == val) {
        return false;
    }
    *outVal = (uint32_t)parsed;
    return true;
}
```

## src/comms.h
```c
#ifndef ELLY_COMMS_H_
#define ELLY_COMMS_H_

#include <stdbool.h>
#include <stddef.h>
#include <stdint.h>

#define ELLY_RX_LINE_MAX 256U

void Comms_Init(void);
void Comms_SendLine(const char *jsonLine);
bool Comms_ReceiveLine(char *outBuf, size_t maxLen, uint32_t waitMs);

/* Minimal zero-alloc JSON field extractors for flat command objects */
bool Comms_JsonGetString(const char *json, const char *key, char *out, size_t maxLen);
bool Comms_JsonGetUint(const char *json, const char *key, uint32_t *outVal);

#endif /* ELLY_COMMS_H_ */
```

## src/crypto_auth.c
```c
#include "crypto_auth.h"
#include "fsl_flash.h"
#include "fsl_flash_ffr.h"
#include <stdio.h>
#include <string.h>

#if __has_include("elly_secret.h")
#include "elly_secret.h"
#else
#error "elly_secret.h is missing. Run: python firmware/tools/gen_secrets.py"
#endif

/*
 * Each board derives its own key: devKey = HMAC-SHA256(master, "ELLY-DEV1|" + chipUid).
 * The master secret lives only in the gitignored elly_secret.h and gateway/.env.
 * Commands are signed over cmd|arg|role|seq|bootNonce, so a capture from an earlier
 * boot can never be replayed after a reset (the nonce changes on every boot).
 */
static const uint8_t s_masterKey[32] = ELLY_MASTER_KEY_BYTES;
static uint8_t s_deviceKey[32];
static bool s_uidValid = false;

static uint8_t s_chipUid[16];
static char s_chipUidHex[33] = "00000000000000000000000000000000";
static uint32_t s_lastSeq = 0U;
static uint32_t s_bootNonce = 0U;

static inline uint32_t rotr32(uint32_t x, uint32_t n)
{
    return (x >> n) | (x << (32U - n));
}

static void sha256_transform(uint32_t state[8], const uint8_t block[64])
{
    static const uint32_t k[64] = {
        0x428a2f98U, 0x71374491U, 0xb5c0fbcfU, 0xe9b5dba5U, 0x3956c25bU, 0x59f111f1U, 0x923f82a4U, 0xab1c5ed5U,
        0xd807aa98U, 0x12835b01U, 0x243185beU, 0x550c7dc3U, 0x72be5d74U, 0x80deb1feU, 0x9bdc06a7U, 0xc19bf174U,
        0xe49b69c1U, 0xefbe4786U, 0x0fc19dc6U, 0x240ca1ccU, 0x2de92c6fU, 0x4a7484aaU, 0x5cb0a9dcU, 0x76f988daU,
        0x983e5152U, 0xa831c66dU, 0xb00327c8U, 0xbf597fc7U, 0xc6e00bf3U, 0xd5a79147U, 0x06ca6351U, 0x14292967U,
        0x27b70a85U, 0x2e1b2138U, 0x4d2c6dfcU, 0x53380d13U, 0x650a7354U, 0x766a0abbU, 0x81c2c92eU, 0x92722c85U,
        0xa2bfe8a1U, 0xa81a664bU, 0xc24b8b70U, 0xc76c51a3U, 0xd192e819U, 0xd6990624U, 0xf40e3585U, 0x106aa070U,
        0x19a4c116U, 0x1e376c08U, 0x2748774cU, 0x34b0bcb5U, 0x391c0cb3U, 0x4ed8aa4aU, 0x5b9cca4fU, 0x682e6ff3U,
        0x748f82eeU, 0x78a5636fU, 0x84c87814U, 0x8cc70208U, 0x90befffaU, 0xa4506cebU, 0xbef9a3f7U, 0xc67178f2U
    };
    uint32_t w[64];
    for (uint32_t i = 0U; i < 16U; i++) {
        w[i] = ((uint32_t)block[i * 4U] << 24) |
               ((uint32_t)block[i * 4U + 1U] << 16) |
               ((uint32_t)block[i * 4U + 2U] << 8) |
               (uint32_t)block[i * 4U + 3U];
    }
    for (uint32_t i = 16U; i < 64U; i++) {
        uint32_t s0 = rotr32(w[i - 15U], 7U) ^ rotr32(w[i - 15U], 18U) ^ (w[i - 15U] >> 3);
        uint32_t s1 = rotr32(w[i - 2U], 17U) ^ rotr32(w[i - 2U], 19U) ^ (w[i - 2U] >> 10);
        w[i] = w[i - 16U] + s0 + w[i - 7U] + s1;
    }

    uint32_t a = state[0], b = state[1], c = state[2], d = state[3];
    uint32_t e = state[4], f = state[5], g = state[6], h = state[7];
    for (uint32_t i = 0U; i < 64U; i++) {
        uint32_t S1    = rotr32(e, 6U) ^ rotr32(e, 11U) ^ rotr32(e, 25U);
        uint32_t ch    = (e & f) ^ ((~e) & g);
        uint32_t temp1 = h + S1 + ch + k[i] + w[i];
        uint32_t S0    = rotr32(a, 2U) ^ rotr32(a, 13U) ^ rotr32(a, 22U);
        uint32_t maj   = (a & b) ^ (a & c) ^ (b & c);
        uint32_t temp2 = S0 + maj;

        h = g; g = f; f = e; e = d + temp1;
        d = c; c = b; b = a; a = temp1 + temp2;
    }

    state[0] += a; state[1] += b; state[2] += c; state[3] += d;
    state[4] += e; state[5] += f; state[6] += g; state[7] += h;
}

typedef struct {
    uint32_t state[8];
    uint64_t bitCount;
    uint8_t buffer[64];
    size_t bufferLen;
} sha256_ctx_t;

static void sha256_init(sha256_ctx_t *ctx)
{
    ctx->state[0] = 0x6a09e667U; ctx->state[1] = 0xbb67ae85U;
    ctx->state[2] = 0x3c6ef372U; ctx->state[3] = 0xa54ff53aU;
    ctx->state[4] = 0x510e527fU; ctx->state[5] = 0x9b05688cU;
    ctx->state[6] = 0x1f83d9abU; ctx->state[7] = 0x5be0cd19U;
    ctx->bitCount = 0U;
    ctx->bufferLen = 0U;
}

static void sha256_update(sha256_ctx_t *ctx, const uint8_t *data, size_t len)
{
    for (size_t i = 0U; i < len; i++) {
        ctx->buffer[ctx->bufferLen++] = data[i];
        ctx->bitCount += 8U;
        if (ctx->bufferLen == 64U) {
            sha256_transform(ctx->state, ctx->buffer);
            ctx->bufferLen = 0U;
        }
    }
}

static void sha256_final(sha256_ctx_t *ctx, uint8_t out32[32])
{
    uint64_t totalBits = ctx->bitCount;
    ctx->buffer[ctx->bufferLen++] = 0x80U;
    if (ctx->bufferLen > 56U) {
        while (ctx->bufferLen < 64U) {
            ctx->buffer[ctx->bufferLen++] = 0x00U;
        }
        sha256_transform(ctx->state, ctx->buffer);
        ctx->bufferLen = 0U;
    }
    while (ctx->bufferLen < 56U) {
        ctx->buffer[ctx->bufferLen++] = 0x00U;
    }
    for (int i = 7; i >= 0; i--) {
        ctx->buffer[ctx->bufferLen++] = (uint8_t)((totalBits >> (i * 8)) & 0xFFU);
    }
    sha256_transform(ctx->state, ctx->buffer);

    for (uint32_t i = 0U; i < 8U; i++) {
        out32[i * 4U]      = (uint8_t)((ctx->state[i] >> 24) & 0xFFU);
        out32[i * 4U + 1U] = (uint8_t)((ctx->state[i] >> 16) & 0xFFU);
        out32[i * 4U + 2U] = (uint8_t)((ctx->state[i] >> 8) & 0xFFU);
        out32[i * 4U + 3U] = (uint8_t)(ctx->state[i] & 0xFFU);
    }
}

void CryptoAuth_Sha256(const uint8_t *data, size_t len, uint8_t out32[32])
{
    sha256_ctx_t ctx;
    sha256_init(&ctx);
    sha256_update(&ctx, data, len);
    sha256_final(&ctx, out32);
}

void CryptoAuth_HmacSha256(const uint8_t *key, size_t keyLen,
                           const uint8_t *msg, size_t msgLen,
                           uint8_t out32[32])
{
    uint8_t kPad[64];
    uint8_t innerHash[32];
    sha256_ctx_t ctx;

    memset(kPad, 0, sizeof(kPad));
    if (keyLen > 64U) {
        CryptoAuth_Sha256(key, keyLen, kPad);
    } else {
        memcpy(kPad, key, keyLen);
    }

    for (size_t i = 0U; i < 64U; i++) {
        kPad[i] ^= 0x36U;
    }
    sha256_init(&ctx);
    sha256_update(&ctx, kPad, 64U);
    sha256_update(&ctx, msg, msgLen);
    sha256_final(&ctx, innerHash);

    for (size_t i = 0U; i < 64U; i++) {
        kPad[i] ^= (0x36U ^ 0x5cU);
    }
    sha256_init(&ctx);
    sha256_update(&ctx, kPad, 64U);
    sha256_update(&ctx, innerHash, 32U);
    sha256_final(&ctx, out32);
}

void CryptoAuth_HexEncode(const uint8_t *in, size_t len, char *outHex)
{
    static const char hex[] = "0123456789abcdef";
    for (size_t i = 0U; i < len; i++) {
        outHex[i * 2U]      = hex[(in[i] >> 4) & 0x0FU];
        outHex[i * 2U + 1U] = hex[in[i] & 0x0FU];
    }
    outHex[len * 2U] = '\0';
}

static int hex_nibble(char c)
{
    if ((c >= '0') && (c <= '9')) return c - '0';
    if ((c >= 'a') && (c <= 'f')) return c - 'a' + 10;
    if ((c >= 'A') && (c <= 'F')) return c - 'A' + 10;
    return -1;
}

static bool hex_decode_32(const char *hexStr, uint8_t out32[32])
{
    if ((hexStr == NULL) || (strlen(hexStr) != 64U)) {
        return false;
    }
    for (size_t i = 0U; i < 32U; i++) {
        int hi = hex_nibble(hexStr[i * 2U]);
        int lo = hex_nibble(hexStr[i * 2U + 1U]);
        if ((hi < 0) || (lo < 0)) {
            return false;
        }
        out32[i] = (uint8_t)((hi << 4) | lo);
    }
    return true;
}

void CryptoAuth_Init(void)
{
    flash_config_t flashCfg;
    memset(&flashCfg, 0, sizeof(flashCfg));
    memset(s_chipUid, 0, sizeof(s_chipUid));
    s_uidValid = false;

    if ((FLASH_Init(&flashCfg) == kStatus_FLASH_Success) &&
        (FFR_Init(&flashCfg) == kStatus_FLASH_Success)) {
        if (FFR_GetUUID(&flashCfg, s_chipUid) == kStatus_FLASH_Success) {
            uint8_t acc = 0U;
            for (size_t i = 0U; i < sizeof(s_chipUid); i++) {
                acc |= s_chipUid[i];
            }
            s_uidValid = (acc != 0U);
        }
    }
    CryptoAuth_HexEncode(s_chipUid, sizeof(s_chipUid), s_chipUidHex);

    char label[48];
    int n = snprintf(label, sizeof(label), "ELLY-DEV1|%s", s_chipUidHex);
    CryptoAuth_HmacSha256(s_masterKey, sizeof(s_masterKey), (const uint8_t *)label, (size_t)n, s_deviceKey);

    s_lastSeq   = 0U;
    s_bootNonce = 0U;
}

void CryptoAuth_SetBootNonce(uint32_t nonce)
{
    s_bootNonce = nonce;
    s_lastSeq   = 0U;
}

uint32_t CryptoAuth_GetBootNonce(void)
{
    return s_bootNonce;
}

bool CryptoAuth_UidValid(void)
{
    return s_uidValid;
}

void CryptoAuth_GetUidHex(char *out33Chars)
{
    memcpy(out33Chars, s_chipUidHex, 33U);
}

uint32_t CryptoAuth_GetLastSeq(void)
{
    return s_lastSeq;
}

bool CryptoAuth_ParseRole(const char *roleStr, elly_role_t *outRole)
{
    if ((roleStr == NULL) || (outRole == NULL)) {
        return false;
    }
    if (strcmp(roleStr, "owner") == 0) {
        *outRole = ELLY_ROLE_OWNER;
        return true;
    }
    if (strcmp(roleStr, "family") == 0) {
        *outRole = ELLY_ROLE_FAMILY;
        return true;
    }
    if (strcmp(roleStr, "guest") == 0) {
        *outRole = ELLY_ROLE_GUEST;
        return true;
    }
    if (strcmp(roleStr, "system") == 0) {
        *outRole = ELLY_ROLE_SYSTEM;
        return true;
    }
    return false;
}

static bool cmd_in(const char *cmd, const char *const *list, size_t n)
{
    for (size_t i = 0U; i < n; i++) {
        if (strcmp(cmd, list[i]) == 0) {
            return true;
        }
    }
    return false;
}

/* Keep in sync with gateway/src/hmac.js (checked by firmware/tools/host_test) */
bool CryptoAuth_IsAllowed(elly_role_t role, const char *cmd, const char *arg)
{
    static const char *const kDiag[]   = { "ping", "audit_dump", "backfill_sync", "can_diag", "flash_id" };
    static const char *const kGuest[]  = { "light", "rgb", "emergency" };
    static const char *const kFamily[] = { "fan", "ac", "eco", "all_off", "night", "alert_test" };
    static const char *const kSystem[] = { "heartbeat", "trip" };

    if ((cmd == NULL) || (arg == NULL)) {
        return false;
    }

    if (role == ELLY_ROLE_SYSTEM) {
        return cmd_in(cmd, kSystem, sizeof(kSystem) / sizeof(kSystem[0])) ||
               cmd_in(cmd, kDiag, sizeof(kDiag) / sizeof(kDiag[0]));
    }
    if (strcmp(cmd, "heartbeat") == 0) {
        return role == ELLY_ROLE_OWNER;
    }
    if (role == ELLY_ROLE_OWNER) {
        return strcmp(cmd, "trip") != 0;
    }

    /* Safety first: anyone in the house can hit Emergency, and anyone can turn privacy ON */
    if (cmd_in(cmd, kGuest, sizeof(kGuest) / sizeof(kGuest[0]))) {
        return true;
    }
    if (strcmp(cmd, "privacy") == 0) {
        return (strcmp(arg, "on") == 0) || (role == ELLY_ROLE_FAMILY);
    }
    if (role == ELLY_ROLE_FAMILY) {
        return cmd_in(cmd, kFamily, sizeof(kFamily) / sizeof(kFamily[0]));
    }
    return false;
}

auth_result_t CryptoAuth_VerifyCommand(const char *cmd, const char *arg,
                                       const char *roleStr, uint32_t seq,
                                       const char *sigHex, elly_role_t *outRole)
{
    elly_role_t role;
    uint8_t providedSig[32];
    uint8_t expectedSig[32];
    char canonical[176];

    if ((cmd == NULL) || (roleStr == NULL) || (sigHex == NULL) || (outRole == NULL)) {
        return AUTH_ERR_FORMAT;
    }
    if (!s_uidValid) {
        return AUTH_ERR_NO_UID;
    }
    if (!CryptoAuth_ParseRole(roleStr, &role)) {
        return AUTH_ERR_FORMAT;
    }
    if (!hex_decode_32(sigHex, providedSig)) {
        return AUTH_ERR_BAD_HMAC;
    }

    int len = snprintf(canonical, sizeof(canonical), "%s|%s|%s|%lu|%lu",
                       cmd, (arg != NULL) ? arg : "", roleStr,
                       (unsigned long)seq, (unsigned long)s_bootNonce);
    if ((len <= 0) || ((size_t)len >= sizeof(canonical))) {
        return AUTH_ERR_FORMAT;
    }

    CryptoAuth_HmacSha256(s_deviceKey, sizeof(s_deviceKey),
                          (const uint8_t *)canonical, (size_t)len, expectedSig);

    uint8_t diff = 0U;
    for (size_t i = 0U; i < 32U; i++) {
        diff |= (uint8_t)(providedSig[i] ^ expectedSig[i]);
    }
    if (diff != 0U) {
        return AUTH_ERR_BAD_HMAC;
    }

    if ((seq == 0U) || (seq <= s_lastSeq)) {
        return AUTH_ERR_REPLAY;
    }
    /* A valid signature burns its sequence number even when the role check then fails */
    s_lastSeq = seq;

    if (!CryptoAuth_IsAllowed(role, cmd, (arg != NULL) ? arg : "")) {
        *outRole = role;
        return AUTH_ERR_RBAC_DENIED;
    }

    *outRole = role;
    return AUTH_OK;
}
```

## src/crypto_auth.h
```c
#ifndef ELLY_CRYPTO_AUTH_H_
#define ELLY_CRYPTO_AUTH_H_

#include "elly_types.h"
#include <stdbool.h>
#include <stddef.h>
#include <stdint.h>

typedef enum {
    AUTH_OK = 0,
    AUTH_ERR_FORMAT,
    AUTH_ERR_BAD_HMAC,
    AUTH_ERR_REPLAY,
    AUTH_ERR_RBAC_DENIED,
    AUTH_ERR_NO_UID,
} auth_result_t;

void CryptoAuth_Init(void);
void CryptoAuth_SetBootNonce(uint32_t nonce);
uint32_t CryptoAuth_GetBootNonce(void);
bool CryptoAuth_UidValid(void);
void CryptoAuth_GetUidHex(char *out33Chars);
uint32_t CryptoAuth_GetLastSeq(void);

void CryptoAuth_Sha256(const uint8_t *data, size_t len, uint8_t out32[32]);
void CryptoAuth_HmacSha256(const uint8_t *key, size_t keyLen,
                           const uint8_t *msg, size_t msgLen,
                           uint8_t out32[32]);
void CryptoAuth_HexEncode(const uint8_t *in, size_t len, char *outHex);

bool CryptoAuth_ParseRole(const char *roleStr, elly_role_t *outRole);
bool CryptoAuth_IsAllowed(elly_role_t role, const char *cmd, const char *arg);
auth_result_t CryptoAuth_VerifyCommand(const char *cmd, const char *arg,
                                       const char *roleStr, uint32_t seq,
                                       const char *sigHex, elly_role_t *outRole);

#endif /* ELLY_CRYPTO_AUTH_H_ */
```

## src/elly_types.h
```c
#ifndef ELLY_TYPES_H_
#define ELLY_TYPES_H_

#include <stdbool.h>
#include <stdint.h>

#define ELLY_FW_VERSION            "1.1.0"
#define ELLY_HEARTBEAT_TIMEOUT_MS  4000U
#define ELLY_TELEMETRY_PERIOD_MS   1000U

/* Vacancy auto-off: 20 min by default (spec), 20 s in demo timing (set from gateway) */
#define ELLY_VACANCY_DEFAULT_MS    1200000U
#define ELLY_VACANCY_MIN_S         10U
#define ELLY_VACANCY_MAX_S         86400U

/* On-die temperature is MCU self-protection only: normal room use sits at 30..45 C */
#define ELLY_TEMP_WARN_C           60.0f
#define ELLY_TEMP_CRIT_C           75.0f
#define ELLY_TEMP_CONFIRM_TICKS    10U

/* Sound level is relative, so claps are detected as a rise over a slow noise floor */
#define ELLY_CLAP_MIN_DB           60.0f
#define ELLY_CLAP_RISE_DB          18.0f
#define ELLY_ACOUSTIC_CLAPS        2U
#define ELLY_ACOUSTIC_WINDOW_MS    3000U

/* Fall = free-fall followed by an impact spike, in calibrated mg */
#define ELLY_FALL_FREEFALL_MG      400
#define ELLY_FALL_FREEFALL_SAMPLES 3U
#define ELLY_FALL_IMPACT_MG        1800
#define ELLY_FALL_WINDOW_MS        600U

typedef enum {
    ELLY_ROLE_GUEST  = 0,
    ELLY_ROLE_FAMILY = 1,
    ELLY_ROLE_OWNER  = 2,
    ELLY_ROLE_SYSTEM = 3, /* gateway automation and firmware self-events, never a human */
} elly_role_t;

typedef enum {
    ELLY_SAFETY_NORMAL    = 0,
    ELLY_SAFETY_THERMAL   = 1,
    ELLY_SAFETY_FALL      = 2,
    ELLY_SAFETY_TAMPER    = 3,
    ELLY_SAFETY_ACOUSTIC  = 4,
    ELLY_SAFETY_EDGE_LOST = 5,
    ELLY_SAFETY_EMERGENCY = 6,
} elly_safety_t;

typedef struct {
    int16_t accel_x_mg;
    int16_t accel_y_mg;
    int16_t accel_z_mg;
    uint16_t vib_rms_mg; /* mean absolute change of |a| over 0.5 s, not a true RMS */
    float lux;           /* relative light index, not calibrated lux */
    float temp_c;        /* on-die temperature */
    float mic_db;        /* relative sound level, not SPL */
    float mic_peak_db;
    float mic_floor_db;
    bool clap_detected;
    bool fall_detected;  /* sticky until the safety task consumes it */
    bool dock_attached;
    bool sw2_pressed;
    bool sw3_pressed;
    bool can_loopback_ok;
    bool accel_ok;
    bool accel_cal;
    bool adc_ok;
} elly_sensor_data_t;

typedef struct {
    bool light_on;
    uint8_t light_pct;
    bool fan_on;
    bool ac_on;
    bool away_armed;
    bool auto_eco;
    bool edge_mode;
    bool privacy_mode;
    bool safety_latched;
    elly_safety_t safety_reason;
    uint8_t led_r;
    uint8_t led_g;
    uint8_t led_b;
    uint32_t last_heartbeat_ms;
    uint32_t last_motion_ms;
    uint32_t uptime_ms;
    uint32_t vacancy_ms;
} elly_state_t;

#endif /* ELLY_TYPES_H_ */
```

## src/flash_log.c
```c
#include "flash_log.h"
#include "app.h"
#include "crypto_auth.h"
#include "fsl_gpio.h"
#include "fsl_lpspi.h"
#include "FreeRTOS.h"
#include "semphr.h"
#include "task.h"
#include <stddef.h>
#include <string.h>

/*
 * Bounded wear-safe layout inside W25Q64 (8 MiB):
 *   Audit Log Ring       : 0x100000 .. 0x11FFFF (32 sectors = 128 KiB, 2048 slots x 64B)
 *   Offline Telemetry Ring: 0x120000 .. 0x13FFFF (32 sectors = 128 KiB, 4096 slots x 32B)
 * Only wrapped circular sector erases are ever issued, throttled by min interval.
 */
#define W25Q_SECTOR_SIZE        4096U
#define W25Q_PAGE_SIZE          256U

#define AUDIT_BASE_ADDR         0x100000U
#define AUDIT_SECTOR_COUNT      32U
#define AUDIT_SLOTS_PER_SECTOR  (W25Q_SECTOR_SIZE / sizeof(flash_audit_rec_t))
#define AUDIT_TOTAL_SLOTS       (AUDIT_SECTOR_COUNT * AUDIT_SLOTS_PER_SECTOR)
#define AUDIT_MAGIC             0x454C4155U /* 'ELAU' */

#define TELEM_BASE_ADDR         0x120000U
#define TELEM_SECTOR_COUNT      32U
#define TELEM_SLOTS_PER_SECTOR  (W25Q_SECTOR_SIZE / sizeof(flash_telem_rec_t))
#define TELEM_TOTAL_SLOTS       (TELEM_SECTOR_COUNT * TELEM_SLOTS_PER_SECTOR)
#define TELEM_MAGIC             0x454C544DU /* 'ELTM' */

#define CMD_JEDEC_ID            0x9FU
#define CMD_MFR_DEV_ID          0x90U
#define CMD_READ_SR1            0x05U
#define CMD_WRITE_ENABLE        0x06U
#define CMD_READ_DATA           0x03U
#define CMD_PAGE_PROGRAM        0x02U
#define CMD_SECTOR_ERASE_4K     0x20U

static SemaphoreHandle_t s_flashMutex = NULL;
static flash_status_t s_status;
static uint32_t s_auditWriteIdx = 0U;
static uint32_t s_auditSeq      = 0U;
static uint8_t s_chainTip[8]    = {0};

static uint32_t s_telemWriteIdx = 0U;
static uint32_t s_telemReadIdx  = 0U;
static uint32_t s_telemSeq      = 0U;
static uint32_t s_lastTelemTick = 0U;

static inline void cs_low(void)
{
    GPIO_PinWrite(ELLY_FLASH_CS_GPIO, ELLY_FLASH_CS_PIN, 0U);
}

static inline void cs_high(void)
{
    GPIO_PinWrite(ELLY_FLASH_CS_GPIO, ELLY_FLASH_CS_PIN, 1U);
}

static bool spi_xfer(const uint8_t *tx, uint8_t *rx, size_t len)
{
    lpspi_transfer_t xfer;
    xfer.txData      = tx;
    xfer.rxData      = rx;
    xfer.dataSize    = len;
    xfer.configFlags = kLPSPI_MasterPcs0;
    return LPSPI_MasterTransferBlocking(ELLY_FLASH_LPSPI, &xfer) == kStatus_Success;
}

static void w25q_read_bytes(uint32_t addr, uint8_t *out, size_t len)
{
    uint8_t hdr[4] = {
        CMD_READ_DATA,
        (uint8_t)((addr >> 16) & 0xFFU),
        (uint8_t)((addr >> 8) & 0xFFU),
        (uint8_t)(addr & 0xFFU),
    };
    cs_low();
    (void)spi_xfer(hdr, NULL, sizeof(hdr));
    if (len > 0U) {
        (void)spi_xfer(NULL, out, len);
    }
    cs_high();
}

static uint8_t w25q_read_sr1(void)
{
    uint8_t tx[2] = { CMD_READ_SR1, 0xFFU };
    uint8_t rx[2] = { 0U, 0xFFU };
    cs_low();
    (void)spi_xfer(tx, rx, sizeof(tx));
    cs_high();
    return rx[1];
}

static bool w25q_wait_ready(uint32_t timeoutMs)
{
    uint32_t spins = timeoutMs * 200U;
    while ((w25q_read_sr1() & 0x01U) != 0U) {
        if (spins-- == 0U) {
            return false;
        }
        if (xTaskGetSchedulerState() == taskSCHEDULER_RUNNING) {
            vTaskDelay(pdMS_TO_TICKS(1U));
        }
    }
    return true;
}

static void w25q_write_enable(void)
{
    uint8_t cmd = CMD_WRITE_ENABLE;
    cs_low();
    (void)spi_xfer(&cmd, NULL, 1U);
    cs_high();
}

static bool w25q_erase_sector(uint32_t addr)
{
    uint32_t aligned = addr & ~(W25Q_SECTOR_SIZE - 1U);
    bool inAudit     = (aligned >= AUDIT_BASE_ADDR) &&
                       (aligned < (AUDIT_BASE_ADDR + AUDIT_SECTOR_COUNT * W25Q_SECTOR_SIZE));
    bool inTelem     = (aligned >= TELEM_BASE_ADDR) &&
                       (aligned < (TELEM_BASE_ADDR + TELEM_SECTOR_COUNT * W25Q_SECTOR_SIZE));
    if (!inAudit && !inTelem) {
        return false;
    }

    w25q_write_enable();
    uint8_t cmd[4] = {
        CMD_SECTOR_ERASE_4K,
        (uint8_t)((aligned >> 16) & 0xFFU),
        (uint8_t)((aligned >> 8) & 0xFFU),
        (uint8_t)(aligned & 0xFFU),
    };
    cs_low();
    (void)spi_xfer(cmd, NULL, sizeof(cmd));
    cs_high();

    if (!w25q_wait_ready(400U)) {
        return false;
    }
    s_status.erase_count++;
    return true;
}

static bool w25q_program_page_chunk(uint32_t addr, const uint8_t *data, size_t len)
{
    if ((len == 0U) || (len > W25Q_PAGE_SIZE)) {
        return false;
    }
    w25q_write_enable();
    uint8_t hdr[4] = {
        CMD_PAGE_PROGRAM,
        (uint8_t)((addr >> 16) & 0xFFU),
        (uint8_t)((addr >> 8) & 0xFFU),
        (uint8_t)(addr & 0xFFU),
    };
    cs_low();
    (void)spi_xfer(hdr, NULL, sizeof(hdr));
    (void)spi_xfer(data, NULL, len);
    cs_high();

    return w25q_wait_ready(50U);
}

static uint32_t crc32_compute(const uint8_t *buf, size_t len)
{
    uint32_t crc = 0xFFFFFFFFU;
    for (size_t i = 0U; i < len; i++) {
        crc ^= buf[i];
        for (uint32_t b = 0U; b < 8U; b++) {
            crc = (crc & 1U) ? ((crc >> 1) ^ 0xEDB88320U) : (crc >> 1);
        }
    }
    return ~crc;
}

static void probe_jedec(void)
{
    uint8_t tx4[4] = { CMD_JEDEC_ID, 0xFFU, 0xFFU, 0xFFU };
    uint8_t rx4[4] = { 0 };
    cs_low();
    (void)spi_xfer(tx4, rx4, sizeof(tx4));
    cs_high();
    s_status.jedec_mfr  = rx4[1];
    s_status.jedec_type = rx4[2];
    s_status.jedec_cap  = rx4[3];

    uint8_t tx6[6] = { CMD_MFR_DEV_ID, 0x00U, 0x00U, 0x00U, 0xFFU, 0xFFU };
    uint8_t rx6[6] = { 0 };
    cs_low();
    (void)spi_xfer(tx6, rx6, sizeof(tx6));
    cs_high();
    s_status.dev_mfr = rx6[4];
    s_status.dev_id  = rx6[5];

    s_status.flash_ok = (s_status.jedec_mfr == 0xEFU) && (s_status.dev_id == 0x16U);
}

static void scan_existing_rings(void)
{
    flash_audit_rec_t rec;
    uint32_t bestSeq = 0U;
    uint32_t bestIdx = 0U;
    bool foundAny    = false;

    for (uint32_t s = 0U; s < AUDIT_SECTOR_COUNT; s++) {
        for (uint32_t slot = 0U; slot < AUDIT_SLOTS_PER_SECTOR; slot++) {
            uint32_t idx  = s * AUDIT_SLOTS_PER_SECTOR + slot;
            uint32_t addr = AUDIT_BASE_ADDR + idx * sizeof(flash_audit_rec_t);
            w25q_read_bytes(addr, (uint8_t *)&rec, 12U);
            if (rec.magic == 0xFFFFFFFFU) {
                break;
            }
            if ((rec.magic == AUDIT_MAGIC) && (rec.seq >= bestSeq)) {
                w25q_read_bytes(addr, (uint8_t *)&rec, sizeof(rec));
                bestSeq  = rec.seq;
                bestIdx  = idx;
                foundAny = true;
                memcpy(s_chainTip, rec.entry_hash, 8U);
            }
        }
    }

    if (foundAny) {
        s_auditSeq      = bestSeq;
        s_auditWriteIdx = (bestIdx + 1U) % AUDIT_TOTAL_SLOTS;
        s_status.audit_count = bestSeq;
    } else {
        s_auditSeq      = 0U;
        s_auditWriteIdx = 0U;
        memset(s_chainTip, 0, sizeof(s_chainTip));
        s_status.audit_count = 0U;
    }

    s_telemSeq      = 0U;
    s_telemWriteIdx = 0U;
    s_telemReadIdx  = 0U;
    s_status.telem_buffered = 0U;

    flash_telem_rec_t trec;
    uint32_t tBestSeq = 0U;
    uint32_t tBestIdx = 0U;
    bool tFound       = false;
    for (uint32_t s = 0U; s < TELEM_SECTOR_COUNT; s++) {
        uint32_t addr = TELEM_BASE_ADDR + s * W25Q_SECTOR_SIZE;
        w25q_read_bytes(addr, (uint8_t *)&trec, 8U);
        if (trec.magic != TELEM_MAGIC) {
            continue;
        }
        for (uint32_t slot = 0U; slot < TELEM_SLOTS_PER_SECTOR; slot++) {
            uint32_t idx = s * TELEM_SLOTS_PER_SECTOR + slot;
            w25q_read_bytes(TELEM_BASE_ADDR + idx * sizeof(flash_telem_rec_t), (uint8_t *)&trec, 8U);
            if (trec.magic == 0xFFFFFFFFU) {
                break;
            }
            if ((trec.magic == TELEM_MAGIC) && (trec.seq >= tBestSeq)) {
                tBestSeq = trec.seq;
                tBestIdx = idx;
                tFound   = true;
            }
        }
    }
    if (tFound) {
        s_telemSeq      = tBestSeq;
        s_telemWriteIdx = (tBestIdx + 1U) % TELEM_TOTAL_SLOTS;
        s_telemReadIdx  = s_telemWriteIdx;
    }
}

void FlashLog_Init(void)
{
    lpspi_master_config_t cfg;
    if (s_flashMutex == NULL) {
        s_flashMutex = xSemaphoreCreateMutex();
    }
    memset(&s_status, 0, sizeof(s_status));

    LPSPI_MasterGetDefaultConfig(&cfg);
    cfg.baudRate                      = ELLY_FLASH_BAUD_HZ;
    cfg.bitsPerFrame                  = 8U;
    cfg.cpol                          = kLPSPI_ClockPolarityActiveHigh;
    cfg.cpha                          = kLPSPI_ClockPhaseFirstEdge;
    cfg.direction                     = kLPSPI_MsbFirst;
    cfg.pinCfg                        = kLPSPI_SdiInSdoOut;
    cfg.whichPcs                      = kLPSPI_Pcs0;
    cfg.pcsActiveHighOrLow            = kLPSPI_PcsActiveLow;
    cfg.pcsToSckDelayInNanoSec        = 50U;
    cfg.lastSckToPcsDelayInNanoSec    = 50U;
    cfg.betweenTransferDelayInNanoSec = 50U;

    LPSPI_MasterInit(ELLY_FLASH_LPSPI, &cfg, ELLY_FLASH_CLK_FREQ);
    cs_high();

    probe_jedec();
    if (s_status.flash_ok) {
        scan_existing_rings();
    }
}

void FlashLog_GetStatus(flash_status_t *out)
{
    if (out == NULL) {
        return;
    }
    if ((s_flashMutex != NULL) && (xTaskGetSchedulerState() == taskSCHEDULER_RUNNING)) {
        (void)xSemaphoreTake(s_flashMutex, portMAX_DELAY);
    }
    *out = s_status;
    if ((s_flashMutex != NULL) && (xTaskGetSchedulerState() == taskSCHEDULER_RUNNING)) {
        (void)xSemaphoreGive(s_flashMutex);
    }
}

uint32_t FlashLog_GetLastAuditSeq(void)
{
    return s_auditSeq;
}

bool FlashLog_AppendAudit(audit_event_t evt, elly_role_t role, const char *detail)
{
    if (!s_status.flash_ok) {
        return false;
    }

    if ((s_flashMutex != NULL) && (xTaskGetSchedulerState() == taskSCHEDULER_RUNNING)) {
        (void)xSemaphoreTake(s_flashMutex, portMAX_DELAY);
    }

    uint32_t slotInSector = s_auditWriteIdx % AUDIT_SLOTS_PER_SECTOR;
    uint32_t addr         = AUDIT_BASE_ADDR + s_auditWriteIdx * sizeof(flash_audit_rec_t);

    /* Check if target slot is erased; erase the 4KB sector only at boundary or if dirty */
    uint32_t probeWord = 0U;
    w25q_read_bytes(addr, (uint8_t *)&probeWord, sizeof(probeWord));
    if ((slotInSector == 0U && probeWord != 0xFFFFFFFFU) || (probeWord != 0xFFFFFFFFU)) {
        uint32_t sectorBase = addr & ~(W25Q_SECTOR_SIZE - 1U);
        if (!w25q_erase_sector(sectorBase)) {
            if ((s_flashMutex != NULL) && (xTaskGetSchedulerState() == taskSCHEDULER_RUNNING)) {
                (void)xSemaphoreGive(s_flashMutex);
            }
            return false;
        }
        s_auditWriteIdx = ((sectorBase - AUDIT_BASE_ADDR) / sizeof(flash_audit_rec_t));
        addr            = sectorBase;
    }

    flash_audit_rec_t rec;
    memset(&rec, 0, sizeof(rec));
    rec.magic      = AUDIT_MAGIC;
    rec.seq        = ++s_auditSeq;
    rec.uptime_ms  = (xTaskGetSchedulerState() == taskSCHEDULER_RUNNING)
                         ? (uint32_t)(xTaskGetTickCount() * portTICK_PERIOD_MS)
                         : 0U;
    rec.event_type = (uint8_t)evt;
    rec.role       = (uint8_t)role;
    rec.flags      = 0U;
    if (detail != NULL) {
        size_t n = strlen(detail);
        if (n >= sizeof(rec.detail)) {
            n = sizeof(rec.detail) - 1U;
        }
        memcpy(rec.detail, detail, n);
    }
    memcpy(rec.prev_hash, s_chainTip, 8U);

    uint8_t fullHash[32];
    CryptoAuth_Sha256((const uint8_t *)&rec, offsetof(flash_audit_rec_t, entry_hash), fullHash);
    memcpy(rec.entry_hash, fullHash, 16U);

    bool ok = w25q_program_page_chunk(addr, (const uint8_t *)&rec, sizeof(rec));
    if (ok) {
        memcpy(s_chainTip, rec.entry_hash, 8U);
        s_auditWriteIdx = (s_auditWriteIdx + 1U) % AUDIT_TOTAL_SLOTS;
        s_status.audit_count++;
    }

    if ((s_flashMutex != NULL) && (xTaskGetSchedulerState() == taskSCHEDULER_RUNNING)) {
        (void)xSemaphoreGive(s_flashMutex);
    }
    return ok;
}

bool FlashLog_PushOfflineTelemetry(const elly_sensor_data_t *s, const elly_state_t *st)
{
    if (!s_status.flash_ok || (s == NULL) || (st == NULL)) {
        return false;
    }

    /* Rate-limit offline flash writes to at most 1 Hz to avoid unnecessary flash wear */
    uint32_t nowMs = st->uptime_ms;
    if ((s_lastTelemTick != 0U) && ((nowMs - s_lastTelemTick) < 950U)) {
        return false;
    }
    s_lastTelemTick = nowMs;

    if ((s_flashMutex != NULL) && (xTaskGetSchedulerState() == taskSCHEDULER_RUNNING)) {
        (void)xSemaphoreTake(s_flashMutex, portMAX_DELAY);
    }

    uint32_t addr = TELEM_BASE_ADDR + s_telemWriteIdx * sizeof(flash_telem_rec_t);
    uint32_t probeWord = 0U;
    w25q_read_bytes(addr, (uint8_t *)&probeWord, sizeof(probeWord));
    if (probeWord != 0xFFFFFFFFU) {
        uint32_t sectorBase = addr & ~(W25Q_SECTOR_SIZE - 1U);
        if (!w25q_erase_sector(sectorBase)) {
            if ((s_flashMutex != NULL) && (xTaskGetSchedulerState() == taskSCHEDULER_RUNNING)) {
                (void)xSemaphoreGive(s_flashMutex);
            }
            return false;
        }
        uint32_t baseSlot = (sectorBase - TELEM_BASE_ADDR) / sizeof(flash_telem_rec_t);
        uint32_t endSlot  = baseSlot + TELEM_SLOTS_PER_SECTOR;
        /* Advance read cursor if this sector still held old unread slots */
        if ((s_status.telem_buffered > 0U) &&
            (s_telemReadIdx >= baseSlot) && (s_telemReadIdx < endSlot)) {
            uint32_t dropped = endSlot - s_telemReadIdx;
            s_status.telem_buffered = (s_status.telem_buffered > dropped)
                                          ? (s_status.telem_buffered - dropped)
                                          : 0U;
            s_telemReadIdx = endSlot % TELEM_TOTAL_SLOTS;
        }
        s_telemWriteIdx = baseSlot;
        addr            = sectorBase;
    }

    flash_telem_rec_t rec;
    memset(&rec, 0, sizeof(rec));
    rec.magic       = TELEM_MAGIC;
    rec.seq         = ++s_telemSeq;
    rec.uptime_ms   = st->uptime_ms;
    rec.accel_x_mg  = s->accel_x_mg;
    rec.accel_y_mg  = s->accel_y_mg;
    rec.accel_z_mg  = s->accel_z_mg;
    rec.vib_rms_mg  = s->vib_rms_mg;
    rec.lux_x10     = (uint16_t)((s->lux >= 0.0f) ? (s->lux * 10.0f) : 0.0f);
    rec.temp_c_x100 = (int16_t)(s->temp_c * 100.0f);
    rec.mic_db_x10  = (uint16_t)((s->mic_db >= 0.0f) ? (s->mic_db * 10.0f) : 0.0f);
    rec.flags       = (uint8_t)((st->light_on ? 1U : 0U) |
                                (st->fan_on ? 2U : 0U) |
                                (st->away_armed ? 4U : 0U) |
                                (st->edge_mode ? 8U : 0U) |
                                (st->safety_latched ? 16U : 0U) |
                                (s->dock_attached ? 32U : 0U));
    rec.crc32       = crc32_compute((const uint8_t *)&rec, offsetof(flash_telem_rec_t, crc32));

    bool ok = w25q_program_page_chunk(addr, (const uint8_t *)&rec, sizeof(rec));
    if (ok) {
        s_telemWriteIdx = (s_telemWriteIdx + 1U) % TELEM_TOTAL_SLOTS;
        if (s_status.telem_buffered < TELEM_TOTAL_SLOTS) {
            s_status.telem_buffered++;
        }
    }

    if ((s_flashMutex != NULL) && (xTaskGetSchedulerState() == taskSCHEDULER_RUNNING)) {
        (void)xSemaphoreGive(s_flashMutex);
    }
    return ok;
}

uint32_t FlashLog_DumpRecentAudit(flash_audit_rec_t *outArr, uint32_t maxItems)
{
    if (!s_status.flash_ok || (outArr == NULL) || (maxItems == 0U)) {
        return 0U;
    }

    if ((s_flashMutex != NULL) && (xTaskGetSchedulerState() == taskSCHEDULER_RUNNING)) {
        (void)xSemaphoreTake(s_flashMutex, portMAX_DELAY);
    }

    uint32_t maxScan    = AUDIT_SLOTS_PER_SECTOR * 4U;
    uint32_t validCount = 0U;
    uint32_t emptyRun   = 0U;

    /* Walk backwards from the most recent slot so sector erases leave no blind spot. */
    for (uint32_t step = 1U; (step <= maxScan) && (validCount < maxItems); step++) {
        uint32_t idx = (s_auditWriteIdx + AUDIT_TOTAL_SLOTS - step) % AUDIT_TOTAL_SLOTS;
        flash_audit_rec_t rec;
        w25q_read_bytes(AUDIT_BASE_ADDR + idx * sizeof(flash_audit_rec_t), (uint8_t *)&rec, sizeof(rec));
        if (rec.magic == AUDIT_MAGIC) {
            outArr[validCount++] = rec;
            emptyRun             = 0U;
        } else {
            emptyRun++;
            if ((validCount > 0U) && (emptyRun >= AUDIT_SLOTS_PER_SECTOR)) {
                break;
            }
        }
    }

    for (uint32_t i = 0U; i < (validCount / 2U); i++) {
        flash_audit_rec_t tmp        = outArr[i];
        outArr[i]                    = outArr[validCount - 1U - i];
        outArr[validCount - 1U - i]  = tmp;
    }

    if ((s_flashMutex != NULL) && (xTaskGetSchedulerState() == taskSCHEDULER_RUNNING)) {
        (void)xSemaphoreGive(s_flashMutex);
    }
    return validCount;
}

uint32_t FlashLog_PopOfflineBatch(flash_telem_rec_t *outArr, uint32_t maxItems)
{
    if (!s_status.flash_ok || (outArr == NULL) || (maxItems == 0U)) {
        return 0U;
    }

    if ((s_flashMutex != NULL) && (xTaskGetSchedulerState() == taskSCHEDULER_RUNNING)) {
        (void)xSemaphoreTake(s_flashMutex, portMAX_DELAY);
    }

    uint32_t popped = 0U;
    while ((s_status.telem_buffered > 0U) && (popped < maxItems)) {
        flash_telem_rec_t rec;
        w25q_read_bytes(TELEM_BASE_ADDR + s_telemReadIdx * sizeof(flash_telem_rec_t),
                        (uint8_t *)&rec, sizeof(rec));
        s_telemReadIdx = (s_telemReadIdx + 1U) % TELEM_TOTAL_SLOTS;
        s_status.telem_buffered--;

        if (rec.magic == TELEM_MAGIC) {
            uint32_t expectedCrc = crc32_compute((const uint8_t *)&rec, offsetof(flash_telem_rec_t, crc32));
            if (expectedCrc == rec.crc32) {
                outArr[popped++] = rec;
            }
        }
    }

    if ((s_flashMutex != NULL) && (xTaskGetSchedulerState() == taskSCHEDULER_RUNNING)) {
        (void)xSemaphoreGive(s_flashMutex);
    }
    return popped;
}
```

## src/flash_log.h
```c
#ifndef ELLY_FLASH_LOG_H_
#define ELLY_FLASH_LOG_H_

#include "elly_types.h"
#include <stdbool.h>
#include <stdint.h>

typedef enum {
    AUDIT_EVT_BOOT       = 1,
    AUDIT_EVT_SAFETY     = 2,
    AUDIT_EVT_AUTH_FAIL  = 3,
    AUDIT_EVT_RBAC_DENY  = 4,
    AUDIT_EVT_EDGE_ENTER = 5,
    AUDIT_EVT_EDGE_EXIT  = 6,
    AUDIT_EVT_CMD        = 7,
    AUDIT_EVT_BUTTON     = 8,
    AUDIT_EVT_DOCK       = 9,
} audit_event_t;

typedef struct __attribute__((packed)) {
    uint32_t magic;
    uint32_t seq;
    uint32_t uptime_ms;
    uint8_t event_type;
    uint8_t role;
    uint16_t flags;
    char detail[24];
    uint8_t prev_hash[8];
    uint8_t entry_hash[16];
} flash_audit_rec_t;

typedef struct __attribute__((packed)) {
    uint32_t magic;
    uint32_t seq;
    uint32_t uptime_ms;
    int16_t accel_x_mg;
    int16_t accel_y_mg;
    int16_t accel_z_mg;
    uint16_t vib_rms_mg;
    uint16_t lux_x10;
    int16_t temp_c_x100;
    uint16_t mic_db_x10;
    uint8_t flags;
    uint8_t reserved;
    uint32_t crc32;
} flash_telem_rec_t;

typedef struct {
    bool flash_ok;
    uint8_t jedec_mfr;
    uint8_t jedec_type;
    uint8_t jedec_cap;
    uint8_t dev_mfr;
    uint8_t dev_id;
    uint32_t audit_count;
    uint32_t telem_buffered;
    uint32_t erase_count;
} flash_status_t;

void FlashLog_Init(void);
void FlashLog_GetStatus(flash_status_t *out);
uint32_t FlashLog_GetLastAuditSeq(void);

bool FlashLog_AppendAudit(audit_event_t evt, elly_role_t role, const char *detail);
bool FlashLog_PushOfflineTelemetry(const elly_sensor_data_t *s, const elly_state_t *st);

uint32_t FlashLog_DumpRecentAudit(flash_audit_rec_t *outArr, uint32_t maxItems);
uint32_t FlashLog_PopOfflineBatch(flash_telem_rec_t *outArr, uint32_t maxItems);

#endif /* ELLY_FLASH_LOG_H_ */
```

## src/rgb_led.c
```c
#include "rgb_led.h"
#include "app.h"
#include "fsl_ctimer.h"

/*
 * FRDM-MCXN236 RGB LED is common-anode (active-LOW).
 * CTIMER_UpdatePwmDutycycle(duty) sets HIGH pulse proportion for duty%:
 *   duty = 100 -> 100% HIGH (LED OFF)
 *   duty = 0   -> 0% HIGH / always LOW (LED 100% ON)
 */
static inline uint8_t clamp_pct(uint8_t v)
{
    return (v > 100U) ? 100U : v;
}

static inline uint8_t to_active_low_duty(uint8_t brightnessPct)
{
    return (uint8_t)(100U - clamp_pct(brightnessPct));
}

void RgbLed_Init(void)
{
    ctimer_config_t cfg;
    uint32_t timerClkHz = CLOCK_GetCTimerClkFreq(3U);
    if (timerClkHz == 0U) {
        timerClkHz = 48000000U;
    }

    CTIMER_GetDefaultConfig(&cfg);
    CTIMER_Init(ELLY_RGB_CTIMER, &cfg);

    (void)CTIMER_SetupPwm(ELLY_RGB_CTIMER, ELLY_RGB_PERIOD_CH, ELLY_RGB_RED_CH,
                          100U, ELLY_RGB_PWM_FREQ_HZ, timerClkHz, false);
    (void)CTIMER_SetupPwm(ELLY_RGB_CTIMER, ELLY_RGB_PERIOD_CH, ELLY_RGB_GREEN_CH,
                          100U, ELLY_RGB_PWM_FREQ_HZ, timerClkHz, false);
    (void)CTIMER_SetupPwm(ELLY_RGB_CTIMER, ELLY_RGB_PERIOD_CH, ELLY_RGB_BLUE_CH,
                          100U, ELLY_RGB_PWM_FREQ_HZ, timerClkHz, false);

    CTIMER_StartTimer(ELLY_RGB_CTIMER);
}

void RgbLed_Set(uint8_t rPct, uint8_t gPct, uint8_t bPct)
{
    (void)CTIMER_UpdatePwmDutycycle(ELLY_RGB_CTIMER, ELLY_RGB_PERIOD_CH, ELLY_RGB_RED_CH,
                                    to_active_low_duty(rPct));
    (void)CTIMER_UpdatePwmDutycycle(ELLY_RGB_CTIMER, ELLY_RGB_PERIOD_CH, ELLY_RGB_GREEN_CH,
                                    to_active_low_duty(gPct));
    (void)CTIMER_UpdatePwmDutycycle(ELLY_RGB_CTIMER, ELLY_RGB_PERIOD_CH, ELLY_RGB_BLUE_CH,
                                    to_active_low_duty(bPct));
}
```

## src/rgb_led.h
```c
#ifndef ELLY_RGB_LED_H_
#define ELLY_RGB_LED_H_

#include <stdint.h>

void RgbLed_Init(void);
void RgbLed_Set(uint8_t rPct, uint8_t gPct, uint8_t bPct);

#endif /* ELLY_RGB_LED_H_ */
```

## src/sensors.h
```c
#ifndef ELLY_SENSORS_H_
#define ELLY_SENSORS_H_

#include "elly_types.h"
#include <stdbool.h>
#include <stdint.h>

void Sensors_Init(void);
void Sensors_PollFast(elly_sensor_data_t *data, bool *sw2Edge, bool *sw3Edge, bool *dockEdge);
void Sensors_PollSlow(elly_sensor_data_t *data);
bool Sensors_RunCanLoopback(void);

#endif /* ELLY_SENSORS_H_ */
```
